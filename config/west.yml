## config/west.yml
```yaml
manifest:
  remotes:
    - name: Bemeier
      url-base: https://github.com/Bemeier
  projects:
    - name: zmk
      remote: Bemeier
      revision: schiffre
      import: app/west.yml
  self:
    path: config
```
